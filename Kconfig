## Kconfig
```kconfig
# torabo-tsuki LP (Helix) の zephyr モジュール用 Kconfig

# PAW3222 ドライバ（drivers/paw3222、sekigon-gonnoc/zmk-driver-paw3222 torabo-tsuki-nemu-link の写し）
menuconfig PAW3222
    bool "PAW3222 mouse optical sensor"
    select SPI
    help
      Enable PAW3222 mouse optical sensor.

config ZMK_INPUT_PROCESSOR_SHIFT_SCROLL_AXIS
    bool "Shift で縦／横スクロールを切り替える input processor"
    default y
    depends on ZMK_POINTING

config ZMK_BEHAVIOR_WHEEL_STEP
    bool
    default y
    depends on DT_HAS_ZMK_BEHAVIOR_WHEEL_STEP_ENABLED

config ZMK_BEHAVIOR_SENSOR_ROTATE_DETENT
    bool
    default y
    depends on DT_HAS_ZMK_BEHAVIOR_SENSOR_ROTATE_DETENT_ENABLED

config HELIX_DEBUG_PIN_POLL
    bool "診断用: パネルのピン変化をログに出す"
    default n
```

## config/west.yml
```yaml
manifest:
  remotes:
    - name: zmkfirmware
      url-base: https://github.com/zmkfirmware
    - name: sekigon-gonnoc
      url-base: https://github.com/sekigon-gonnoc
    - name: kot149
      url-base: https://github.com/kot149
    - name: mjmjm0101
      url-base: https://github.com/mjmjm0101
  projects:
    - name: zmk
      remote: zmkfirmware
      revision: v0.3
      import: app/west.yml
    - name: zmk-component-bmp-boost
      remote: sekigon-gonnoc
      import: west.yml
      revision: v0.2
    - name: zmk-feature-status-led
      remote: sekigon-gonnoc
      revision: main
    # zmk-driver-paw3222 は drivers/paw3222 に取り込み済み（11/17、1ms ポーリングのため）
    - name: zmk-driver-iqs7211e
      remote: sekigon-gonnoc
    - name: zmk-feature-cdc-acm-bootloader-trigger
      remote: sekigon-gonnoc
      revision: v0.2
    - name: zmk-feature-non-lipo-battery-management
      remote: sekigon-gonnoc
      revision: main
    - name: zmk-scroll-snap
      remote: kot149
      revision: v1
    - name: zmk-input-processor-scroll-inertia
      remote: mjmjm0101
      revision: main
  self:
    path: config
```

## dts/bindings/behaviors/zmk,behavior-sensor-rotate-detent.yaml
```yaml
description: Sensor rotate that resets remainder on reversal and fires at 3/4 detent

compatible: "zmk,behavior-sensor-rotate-detent"

properties:
  label:
    type: string
    required: false
    deprecated: true
  "#sensor-binding-cells":
    type: int
    required: true
    const: 0
  bindings:
    type: phandle-array
    required: true
  tap-ms:
    type: int
    default: 5
```

## dts/bindings/behaviors/zmk,behavior-wheel-step.yaml
```yaml
description: Send one wheel report (MOVE_X/MOVE_Y encoded amount) per press

compatible: "zmk,behavior-wheel-step"

include: one_param.yaml
```

## dts/bindings/input-processors/zmk,input-processor-shift-scroll-axis.yaml
```yaml
description: |
  スクロールの軸を Shift で切り替える。Shift なし＝縦（REL_WHEEL）だけ、Shift あり＝横（REL_HWHEEL）だけを通す。
  通さない軸のイベントは値を 0 にする（sync を落とさないため、捨てずに残す）。

compatible: "zmk,input-processor-shift-scroll-axis"

properties:
  "#input-processor-cells":
    type: int
    const: 0

  track-remainders:
    type: boolean
    description: input_listener が全 processor について参照する（このプロセッサでは使わない）
```
