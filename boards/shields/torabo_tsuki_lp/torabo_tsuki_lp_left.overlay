#include "torabo_tsuki_lp.dtsi"
#include <input/processors.dtsi>
#include <scroll-snap.dtsi>
#include <dt-bindings/zmk/input_transform.h>

&pointing_listener {
    input-processors = <
        &zip_xy_transform
        (INPUT_TRANSFORM_X_INVERT | INPUT_TRANSFORM_Y_INVERT)
    >;
};

/* 11/19 23:10 左にもトラボを戻した（ピンは右と同じ、snippet input-trackball + input-split）。
 * 11/19 23:08 田上さん: 左エンコーダを Helix 基板のエンコーダ用スルーホール（右下キーの1つ上）へ移設
 * → dtsi の既定 A=B6 (pro_micro 10)・B=B5 (pro_micro 9) をそのまま使う */
&encoder_left {
    status = "okay";
};

/* 拡張パネル(11/19): ステータス LED=P0.31 */
&status_led {
    gpios = <&gpio0 31 GPIO_ACTIVE_HIGH>;
};

/* Helix rev3 の列（ZMK 本体 helix_left.overlay と同じ） */
&kscan0 {
    col-gpios
        = <&pro_micro 21 GPIO_ACTIVE_HIGH>
        , <&pro_micro 20 GPIO_ACTIVE_HIGH>
        , <&pro_micro 19 GPIO_ACTIVE_HIGH>
        , <&pro_micro 18 GPIO_ACTIVE_HIGH>
        , <&pro_micro 15 GPIO_ACTIVE_HIGH>
        , <&pro_micro 14 GPIO_ACTIVE_HIGH>
        , <&pro_micro 16 GPIO_ACTIVE_HIGH>
        ;
};
