#include "torabo_tsuki_lp.dtsi"
#include <input/processors.dtsi>
#include <scroll-snap.dtsi>
#include <dt-bindings/zmk/input_transform.h>

&pointing_listener {
    input-processors = <
        &zip_xy_transform
        (INPUT_TRANSFORM_XY_SWAP | INPUT_TRANSFORM_Y_INVERT)   /* Helix: センサーの向きが torabo と90度違う */
    >;
};

&size_xs_transform {
    col-offset = <7>;
};

/* rev3: Nの左下のエンコーダ（基板のエンコーダ端子 B6/B5） */
&encoder_right {
    status = "okay";
};

// &scroll_inertia {
//     status = "okay";
// };

/* Helix rev3 の列（ZMK 本体 helix_right.overlay と同じ） */
&kscan0 {
    col-gpios
        = <&pro_micro 16 GPIO_ACTIVE_HIGH>
        , <&pro_micro 14 GPIO_ACTIVE_HIGH>
        , <&pro_micro 15 GPIO_ACTIVE_HIGH>
        , <&pro_micro 18 GPIO_ACTIVE_HIGH>
        , <&pro_micro 19 GPIO_ACTIVE_HIGH>
        , <&pro_micro 20 GPIO_ACTIVE_HIGH>
        , <&pro_micro 21 GPIO_ACTIVE_HIGH>
        ;
};
