#include "torabo_tsuki_lp.dtsi"
#include <input/processors.dtsi>
#include <scroll-snap.dtsi>
#include <dt-bindings/zmk/input_transform.h>

&pointing_listener {
    input-processors = <
        &zip_xy_transform
        (INPUT_TRANSFORM_XY_SWAP | INPUT_TRANSFORM_Y_INVERT)   /* Helix: センサーの向きが torabo と90度違う */
    >;
};

&size_xs_transform {
    col-offset = <7>;
};

/* 11/19 23:08 田上さん: 右にはエンコーダを付けない（encoder_right は dtsi の既定で disabled） */

/* 拡張パネル(11/19): ステータス LED=P0.31（43 は MOTION に使う） */
&status_led {
    gpios = <&gpio0 31 GPIO_ACTIVE_HIGH>;
};

// &scroll_inertia {
//     status = "okay";
// };

/* Helix rev3 の列（ZMK 本体 helix_right.overlay と同じ） */
&kscan0 {
    col-gpios
        = <&pro_micro 16 GPIO_ACTIVE_HIGH>
        , <&pro_micro 14 GPIO_ACTIVE_HIGH>
        , <&pro_micro 15 GPIO_ACTIVE_HIGH>
        , <&pro_micro 18 GPIO_ACTIVE_HIGH>
        , <&pro_micro 19 GPIO_ACTIVE_HIGH>
        , <&pro_micro 20 GPIO_ACTIVE_HIGH>
        , <&pro_micro 21 GPIO_ACTIVE_HIGH>
        ;
};
